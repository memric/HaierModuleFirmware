## components/haier/Kconfig.projbuild
```kconfig
menu "Haier Interface Configuration"
    menuconfig HAIER_ENABLE
        bool "Enable Haier protocol"
        default y
        help
            Enable Haier protocol.

        config HAIER_EMULATE_DATA
            bool "Enable Haier data emulation"
            default n
            depends on HAIER_ENABLE
            help
                Enable Haier data emulation.

        menuconfig HAIER_POLL_ENABLE
            bool "Enable Haier polling"
            default y
            depends on HAIER_ENABLE
            help
                Enable Haier polling.

            config HAIER_POLL_TIMER
                int "Haier polling timer, ms"
                default 5000
                depends on HAIER_POLL_ENABLE
                help
                    Haier polling timer, ms.
endmenu
```

## components/mqtt_service/Kconfig.projbuild
```kconfig
menu "MQTT Configuration"
    
    menuconfig MQTT_EN
        bool "Enable MQTT"
        default n
        help
            Enable MQTT functionality.

        config MQTT_BROKER_HOST
            string "MQTT Broker Host"
            default "mqtt://broker.com"
            depends on MQTT_EN
            help
                Host of the MQTT broker.

        config MQTT_BROKER_PORT
            int "Broker port"
            default 1883
            depends on MQTT_EN
            help
                Broker port

        config MQTT_TOPIC
            string "Topic"
            default "haier"
            depends on MQTT_EN
            help
                MQTT high level topic

        menuconfig MQTT_AUTH_EN
            bool "Enable MQTT Autentification"
            default n
            depends on MQTT_EN
            help
                Enable MQTT autentification.

            config MQTT_USER
                string "Username"
                default "user"
                depends on MQTT_AUTH_EN
                help
                    MQTT username

            config MQTT_PASSWORD
                string "Password"
                default "password"
                depends on MQTT_AUTH_EN
                help
                    MQTT password

        menuconfig MQTT_TLS_EN
            bool "Enable MQTT TLS"
            default n
            depends on MQTT_EN
            help
                Enable MQTT TLS.
                mqtt_cert.pem file should be provided.

        menuconfig MQTT_LWT_EN
            bool "Enable MQTT LWT functionality"
            default n
            depends on MQTT_EN
            help
                Enable MQTT LWT functionality.

            config MQTT_LWT_SUBTOPIC
                string "LWT subtopic"
                default "lwt"
                depends on MQTT_LWT_EN
                help
                    LWT subtopic

            config MQTT_LWT_ONLINE_MSG
                string "LWT online message"
                default "online"
                depends on MQTT_LWT_EN
                help
                    LWT online message

            config MQTT_LWT_PERIOD
                int "LWT sending period"
                default 10000
                depends on MQTT_LWT_EN
                help
                    LWT sending period
endmenu
```

## components/telegram_bot/Kconfig.projbuild
```kconfig
menu "Telegram bot Configuration"
    menuconfig TG_EN
        bool "Enable Telegram bot"
        default y
        help
            Enable Tegeram bot functionality.

        if TG_EN
            config TG_BOT_TOKEN
                string "Telegram Bot Token"
                default "token"
                help
                Telegram Bot Token.

            config TG_CHAT_ID
                int "Telegram chat ID"
                default 1
                help
                    Accepted chat ID

        endif # TG_EN
endmenu
```

## components/wifi_service/Kconfig.projbuild
```kconfig
menu "WiFi Configuration"

    config WIFI_SSID
        string "WiFi SSID"
        default "myssid"
        help
            SSID (network name) for the example to connect to.

    config WIFI_PASSWORD
        string "WiFi Password"
        default "mypassword"
        help
            WiFi password (WPA or WPA2) for the example to use.

    config WIFI_RECONNECT_TIMER
        int "Reconnect timeout, s"
        default 60
        help
            Reconnect timeout, s.

    config SYS_OTA_ENABLE
        bool "Enable OTA thrue WiFi & FWTP"
        default y
        help
            Enable OTA thrue WiFi & FWTP.
endmenu
```

## main/Kconfig.projbuild
```kconfig
menu "Controller Configuration"
    config SYS_SENDING_PERIOD
        int "System Information sending period, ms"
        default 5000
        help
            System Information sending period, ms.

    config SYS_TEMP_SENSOR_ENABLE
        bool "Enable SoC temperature sensor"
        default y
        help
            Enable SoC temperature sensor.
endmenu
```

## sdkconfig.defaults
```kconfig
CONFIG_LWIP_LOCAL_HOSTNAME="Haier-Module"
CONFIG_PARTITION_TABLE_TWO_OTA_LARGE=y
CONFIG_ESPTOOLPY_FLASHSIZE_4MB=y
CONFIG_ESPTOOLPY_FLASHSIZE="4MB"
```
